## techpack/data/drivers/rmnet/perf/Kconfig
```kconfig
#
# RMNET_PERF driver
#

config RMNET_PERF
    tristate "Rmnet Perf driver"
    default n
    depends on CFI_PERMISSIVE || !CFI
#    depends on RMNET
    ---help---
        performance mode of rmnet driver
```

## techpack/data/drivers/rmnet/shs/Kconfig
```kconfig
#
# RMNET_SHS driver
#

config RMNET_SHS
    tristate "Rmnet SHS driver"
    default n
    depends on CFI_PERMISSIVE || !CFI
#    depends on RMNET
    ---help---
        performance mode of rmnet driver
```
